VERSION "CAN ALDL Bridge DF 1.1"

BS_: 500000 : 0,0

BU_: ECM
VAL_TABLE_ IDLE_FUEL_CALC 0 "O2" 1 "Airflow";
VAL_TABLE_ RICH_LEAN 0 "LEAN" 1 "RICH";
VAL_TABLE_ LOOP_STATUS 0 "OPEN" 1 "CLOSED";

BO_ 113360 ECM_0: 7 ECM
    SG_ EngineRPM         : 0|8@0+        (25.0,0.0)      [0|0]   "rpm"
    SG_ ThrottlePosition  : 8|8@0+        (0.003906,0.0)  [0|100]   "%"
    SG_ VehicleSpeed      : 16|8@0+        (1.0,0.0)       [0|200]   "mph"
    SG_ EngineAirflow     : 24|8@0+        (1.0,0.0)       [0|0]   "gm/sec"
    SG_ CoolantTemp       : 32|8@0+        (1.35,-40.0)    [0|0]   "F"
    SG_ IntakeAirTemp     : 40|8@0+        (1.35,-40.0)       [0|0]   "F"
    SG_ MAP               : 48|8@0+        (0.369,10.354)  [0|0]   "kPa"

BO_ 113361 ECM_1: 4 ECM
    SG_ DesiredAFR        : 0|8@0+        (0.1,0.0)       [0|0]   "A/F"
    SG_ NarrowbandO2      : 8|8@0+        (4420,0.0)      [0|0]   "V"
    SG_ InjectorBasePulse : 16|16@0+       (0.015259,0.0)  [0|0]   "ms"

BO_ 113362 ECM_2: 5 ECM
    SG_ CurrentBLMCell    : 0|8@0+        (1.0,0.0)       [0|0]   ""
    SG_ BLM               : 8|8@0+        (1.0,0.0)       [0|0]   "counts"
    SG_ Integrator        : 16|8@0+        (1.0,0.0)       [0|0]   "counts"
    SG_ BasePulseFineCorr : 24|8@0+        (1.0,0.0)       [0|0]   "counts"
    SG_ BLMCell0Timer     : 32|8@0+        (1.0,0.0)       [0|0]   "counts"

BO_ 113363 ECM_3: 4 ECM
    SG_ KnockEvents       : 0|8@0+        (1.0,0.0)       [0|0]   "counts"
    SG_ SparkAdvance      : 8|16@0+        (0.35156,0.0)   [0|0]   "deg"
    SG_ KnockRetard       : 24|8@0+        (0.175781,0.0)  [0|0]   "deg"

BO_ 113364 ECM_4: 7 ECM
    SG_ TPSVoltage        : 0|8@0+        (0.019531,0.0)  [0|0]   "V"
    SG_ IACSteps          : 8|8@0+        (1.0,0.0)       [0|0]   "steps"
    SG_ IACMinPosition    : 16|8@0+        (1.0,0.0)       [0|0]   "steps"
    SG_ BarometricPressure : 24|8@0+        (0.369,10.3542) [0|0]   "kPa"
    SG_ EngineRunTime     : 32|16@0+       (1.0,0.0)       [0|0]   "sec"
    SG_ CatalyticConvTemp : 48|8@0+        (3.0,300.0)     [0|0]   "Deg C"

BO_ 113365 ECM_5: 8 ECM
    SG_ FuelPumpVolts     : 0|8@0+        (0.1,0.0)       [0|0]   "V"
    SG_ O2CrossCount      : 8|8@0+        (1.0,0.0)       [0|0]   "counts"
    SG_ DesiredIdleSpeed  : 16|8@0+        (12.5,0.0)      [0|0]   "rpm"
    SG_ BatteryVoltage    : 24|8@0+        (0.1,0.0)       [0|0]   "V"
    SG_ CCPDutyCycle      : 32|8@0+        (0.39065,0.0)   [0|0]   "% CCP"
    SG_ RPMMPH            : 40|8@0+        (1.0,0.0)       [0|0]   "RPM/MPH"
    SG_ ACPressureSensor  : 48|8@0+        (1.0,0.0)       [0|0]   "A/D Counts"
    SG_ CorrosivitySensor : 56|8@0+        (0.0196,0.0)    [0|0]   "V"

BO_ 113366 ECM_6: 2 ECM
    SG_ PROMID            : 0|16@0+         (1.0,0.0)      [0|0]   "ID"

BO_ 113367 ECM_7: 4 ECM
    SG_ MALFF_MODE1_3     : 0|8@0+          (1.0,0.0)      [0|0]   "MALF FLAGS 1"
    SG_ ErrorCrank        : 7|1@0+          (1.0,0.0)      [0|1]   "12 Crank Sensor"
    SG_ ErrorO2Sensor     : 6|1@0+          (1.0,0.0)      [0|1]   "13 O2 Sensor"
    SG_ ErrorCoolantHigh  : 5|1@0+          (1.0,0.0)      [0|1]   "14 Coolant Sensor High"
    SG_ ErrorCoolantLow   : 4|1@0+          (1.0,0.0)      [0|1]   "15 Coolant Sensor Low"
    SG_ ErrorTPSHigh      : 3|1@0+          (1.0,0.0)      [0|1]   "21 TPS High"
    SG_ ErrorTPSLow       : 2|1@0+          (1.0,0.0)      [0|1]   "22 TPS Low"
    SG_ ErrorMATLow       : 1|1@0+          (1.0,0.0)      [0|1]   "23 MAT Low"
    SG_ ErrorVSSLow       : 0|1@0+          (1.0,0.0)      [0|1]   "24 VSS Low"
    SG_ MALFF_MODE1_4     :  8|8@0+         (1.0,0.0)      [0|0]   "MALF FLAGS 2"
    SG_ ErrorMATHigh      : 15|1@0+         (1.0,0.0)      [0|1]   "25 MAT High"
    SG_ ErrorFuelInjector : 14|1@0+         (1.0,0.0)      [0|1]   "31 Fuel Injector"
    SG_ ErrorEGR          : 13|1@0+         (1.0,0.0)      [0|1]   "32 EGR"
    SG_ ErrorMAPHigh      : 12|1@0+         (1.0,0.0)      [0|1]   "33 MAP High"
    SG_ ErrorMAPLow       : 11|1@0+         (1.0,0.0)      [0|1]   "34 MAP Low"
    SG_ ErrorIAC          : 10|1@0+         (1.0,0.0)      [0|1]   "35 IAC"
    SG_ ErrorCylSelect    :  9|1@0+         (1.0,0.0)      [0|1]   "41 Cylinder Select"
    SG_ ErrorKnock        :  8|1@0+         (1.0,0.0)      [0|1]   "42 Knock Sensor"
    SG_ MALFF_MODE1_5     : 16|8@0+         (1.0,0.0)      [0|0]   "MALF FLAGS 3"
    SG_ ErrorKnock        : 23|1@0+         (1.0,0.0)      [0|1]   "43 ESC"
    SG_ ErrorO2Lean       : 22|1@0+         (1.0,0.0)      [0|1]   "44 O2 Lean"
    SG_ ErrorO2Rich       : 21|1@0+         (1.0,0.0)      [0|1]   "45 O2 Rich"
    SG_ ErrorVATS         : 20|1@0+         (1.0,0.0)      [0|1]   "46 VATS"
    SG_ ErrorPROM         : 19|1@0+         (1.0,0.0)      [0|1]   "51 PROM"
    SG_ ErrorVoltageHigh  : 18|1@0+         (1.0,0.0)      [0|1]   "53 Battery Voltage High"
    SG_ ErrorFPumpLow     : 17|1@0+         (1.0,0.0)      [0|1]   "54 Fuel Pump Voltage Low"
    SG_ ErrorADU          : 16|1@0+         (1.0,0.0)      [0|1]   "55 ADU"
    SG_ MALFF_MODE1_6     : 24|8@0+         (1.0,0.0)      [0|0]   "MALF FLAGS 4"
    SG_ ErrorTransSolB    : 27|1@0+         (1.0,0.0)      [0|1]   "36 Tranny Solenoid B"
    SG_ ErrorClutchSw     : 31|1@0+         (1.0,0.0)      [0|1]   "37 Clutch Switch"
    SG_ ErrorDegradedO2   : 30|1@0+         (1.0,0.0)      [0|1]   "61 Degraded O2"
    SG_ ErrorGearSwitch   : 28|1@0+         (1.0,0.0)      [0|1]   "62 Gear Switch"
    SG_ ErrorACPressure   : 25|1@0+         (1.0,0.0)      [0|1]   "66 A/C Pressure Sensor"

BO_ 113368 ECM_8: 8 ECM
    SG_ STATUS1_18        :  0|8@0+          (1.0,0.0)      [0|0]   "Status Flags 1"
    SG_ FAN1              :  4|1@0+          (1.0,0.0)      [0|1]   "Fan 1"
    SG_ FAN1              :  5|1@0+          (1.0,0.0)      [0|1]   "Fan 2"
    SG_ STATUS2_52        :  8|8@0+          (1.0,0.0)      [0|0]   "Status Flags 2"
    SG_ TCCShiftLight     : 11|1@0+          (1.0,0.0)      [0|1]   "TCC/Shift Light On"
    SG_ STATUS3_53        : 16|8@0+          (1.0,0.0)      [0|0]   "Status Flags 3"
    SG_ LowACPressure     : 17|1@0+          (1.0,0.0)      [0|1]   "Low AC Pressure"
    SG_ Defrost           : 18|1@0+          (1.0,0.0)      [0|1]   "Defrost"
    SG_ STATUS4_58        : 24|8@0+          (1.0,0.0)      [0|0]   "Status Flags 4"
    SG_ MALFUNCTION       : 25|1@0+          (1.0,0.0)      [0|1]   "Malfuctions Have Occured"
    SG_ LAUNCHMODE        : 26|1@0+          (1.0,0.0)      [0|1]   "Launch Mode"
    SG_ PURGING           : 30|1@0+          (1.0,0.0)      [0|1]   "Purging"
    SG_ STATUS5_59        : 32|8@0+          (1.0,0.0)      [0|0]   "Status Flags 5"
    SG_ GEAR_2_START      : 33|1@0+          (1.0,0.0)      [0|1]   "Second Gear Start"
    SG_ CLUTCH_PRESSED    : 34|1@0+          (1.0,0.0)      [0|1]   "Clutch Pedal Pressed"
    SG_ AC_REQUESTED      : 39|1@0+          (1.0,0.0)      [0|1]   "AC Requested"
    SG_ STATUS5_60        : 40|8@0+          (1.0,0.0)      [0|0]   "Status Flags 6"
    SG_ O2_SENSOR_RDY     : 40|1@0+          (1.0,0.0)      [0|1]   "O2 Sensor Ready"
    SG_ STATUS6_62        : 48|8@0+          (1.0,0.0)      [0|0]   "Status Flags 7"
    SG_ DECEL_FUEL_CUTOFF : 51|1@0+          (1.0,0.0)      [0|1]   "DFCO"
    SG_ IDLE_FUEL_CALC    : 53|1@0+          (1.0,0.0)      [0|1]   "ENUM IDLE FUEL CALC: 0 is O2, 1 is Airflow"
    SG_ STATUS6_63        : 56|8@0+          (1.0,0.0)      [0|0]   "Status Flags 8"
    SG_ RICH_LEAN         : 61|1@0+          (1.0,0.0)      [0|1]   "ENUM 0 is LEAN, 1 is RICH"
    SG_ LOOP_STATUS       : 63|1@0+          (1.0,0.0)      [0|1]   "ENUM 0 is OPEN, 1 is CLOSED"

VAL_ 113368 IDLE_FUEL_CALC 0 "O2" 1 "Airflow";
VAL_ 113368 RICH_LEAN 0 "LEAN" 1 "RICH";
VAL_ 113368 LOOP_STATUS 0 "OPEN" 1 "CLOSED";
