VERSION "CAN ALDL Bridge DF 1.0"

BS_: 500000 : 0,0

BO_ 896 ECM_0: 7 ALDL_DF_MODE1
    SG_ EngineRPM         : 0|8@0+        (25.0,0.0)      [0|0]   "rpm"
    SG_ ThrottlePosition  : 8|8@0+        (0.003906,0.0)  [0|100]   "%"
    SG_ VehicleSpeed      : 16|8@0+        (1.0,0.0)       [0|200]   "mph"
    SG_ EngineAirflow     : 24|8@0+        (1.0,0.0)       [0|0]   "gm/sec"
    SG_ CoolantTemp       : 32|8@0+        (1.35,-40.0)    [0|0]   "F"
    SG_ IntakeAirTemp     : 40|8@0+        (1.35,-40.0)       [0|0]   "F"
    SG_ MAP               : 48|8@0+        (0.369,10.354)  [0|0]   "kPa"

B0_ 897 ECM_1: 4 ALDL_DF_MODE1
    SG_ DesiredAFR        : 0|8@0+        (0.1,0.0)       [0|0]   "A/F"
    SG_ NarrowbandO2      : 8|8@0+        (4420,0.0)      [0|0]   "V"
    SG_ InjectorBasePulse : 16|16@0+       (0.015259,0.0)  [0|0]   "ms"

B0_ 898 ECM_2: 5 ALDL_DF_MODE1
    SG_ CurrentBLMCell    : 0|8@0+        (1.0,0.0)       [0|0]   ""
    SG_ BLM               : 8|8@0+        (1.0,0.0)       [0|0]   "counts"
    SG_ Integrator        : 16|8@0+        (1.0,0.0)       [0|0]   "counts"
    SG_ BasePulseFineCorr : 24|8@0+        (1.0,0.0)       [0|0]   "counts"
    SG_ BLMCell0Timer     : 32|8@0+        (1.0,0.0)       [0|0]   "counts"

B0_ 898 ECM_3: 4 ALDL_DF_MODE1
    SG_ KnockEvents       : 0|8@0+        (1.0,0.0)       [0|0]   "counts"
    SG_ SparkAdvance      : 8|16@0+        (0.35156,0.0)   [0|0]   "deg"
    SG_ KnockRetard       : 24|8@0+        (0.175781,0.0)  [0|0]   "deg"

B0_ 899 ECM_4: 7 ALDL_DF_MODE1
    SG_ TPSVoltage        : 0|8@0+        (0.019531,0.0)  [0|0]   "V"
    SG_ IACSteps          : 8|8@0+        (1.0,0.0)       [0|0]   "steps"
    SG_ IACMinPosition    : 16|8@0+        (1.0,0.0)       [0|0]   "steps"
    SG_ BarometricPressure : 24|8@0+        (0.369,10.3542) [0|0]   "kPa"
    SG_ EngineRunTime     : 32|16@0+       (1.0,0.0)       [0|0]   "sec"
    SG_ CatalyticConvTemp : 48|8@0+        (3.0,300.0)     [0|0]   "Deg C"

B0_ 900 ECM_5: 8 ALDL_DF_MODE1
    SG_ FuelPumpVolts     : 0|8@0+        (0.1,0.0)       [0|0]   "V"
    SG_ O2CrossCount      : 8|8@0+        (1.0,0.0)       [0|0]   "counts"
    SG_ DesiredIdleSpeed  : 16|8@0+        (12.5,0.0)      [0|0]   "rpm"
    SG_ BatteryVoltage    : 24|8@0+        (0.1,0.0)       [0|0]   "V"
    SG_ CCPDutyCycle      : 32|8@0+        (0.39065,0.0)   [0|0]   "% CCP"
    SG_ RPMMPH            : 40|8@0+        (1.0,0.0)       [0|0]   "RPM/MPH"
    SG_ ACPressureSensor  : 48|8@0+        (1.0,0.0)       [0|0]   "A/D Counts"
    SG_ CorrosivitySensor : 56|8@0+        (0.0196,0.0)    [0|0]   "V"

B0_ 901 ECM_6: 2 ALDL_DF_MODE1
    SG_ PROMID            : 0|16@0+         (1.0,0.0)      [0|0]   "ID"

B0_ 902 ECM_7: 4 ALDL_DF_MODE1
    SG_ MALFF1            : 0|8@0+          (1.0,0.0)      [0|0]   "MALF FLAGS 1"
    SG_ MALFF2            : 8|8@0+         (1.0,0.0)      [0|0]   "MALF FLAGS 2"
    SG_ MALFF3            : 16|8@0+         (1.0,0.0)      [0|0]   "MALF FLAGS 3"
    SG_ MALFF4            : 24|8@0+         (1.0,0.0)      [0|0]   "MALF FLAGS 4"
    SG_ MAP_LOW           : 12|1@0+
